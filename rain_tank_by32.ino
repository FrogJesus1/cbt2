// ─────────────────────────────────────────────────────
// FARM OS — Node Firmware
// Node   : rain_tank_by32
// MCU    : ESP32 Dev Board
// Zone   : unassigned
// Created: 2026-05-30 20:34
//
// Generated by the Node Minter.
// To change sensors, re-run: python minter/compiler.py
// ─────────────────────────────────────────────────────
// Libraries
#include <WiFi.h>
#include <WebServer.h>
#include <HTTPClient.h>
#include <esp_sleep.h>
#include <Preferences.h>
#include <esp_task_wdt.h>
// ── Node Identity ────────────────────────────────────────────
const char* NODE_ID = "rain_tank_by32";
// ── Target Server (dev/prod switching) ───────────────────────
// Defaults to production — updated on boot via config query
char targetServerIP[16] = "192.168.1.200";
int  targetServerPort   = 5050;
// Production server (always used for config query)
const char* PROD_SERVER_IP = "192.168.1.200";
const int   PROD_SERVER_PORT = 5050;
unsigned long lastConfigCheck = 0;
const unsigned long CONFIG_CHECK_INTERVAL = 60000;  // 1 minute
// ── WiFi credentials ─────────────────────────────────────
const char* WIFI_SSID     = "It_Burns_When_IP";
const char* WIFI_PASSWORD = "YOUR_WIFI_PASSWORD";
// HTTP web server on port 80
WebServer server(80);
// Global sensor/actuator objects
// ── YF-S201 Water Flow Sensor (flow 1) ────────────────────
// Yellow wire → GPIO 25 (interrupt), Red → 5V, Black → GND
#define yf_s201_2_PIN 25
float yf_s201_2_cal_factor = 450.0;
volatile unsigned long yf_s201_2_pulseCount = 0;
unsigned long yf_s201_2_lastPulses = 0;  // last sampled count (for POST/calibration)
float yf_s201_2_flowRate = 0;
float yf_s201_2_totalVolume = 0;
void IRAM_ATTR yf_s201_2_pulseCounter() { yf_s201_2_pulseCount++; }
// ── Float Sensor 1 ───────────────────────────────────────
#define float_sensor_PIN 13
int float_sensor_level = 0;
// ── Float Sensor 2 ───────────────────────────────────────
#define float_sensor_2_PIN 14
int float_sensor_2_level = 0;
// ── YF-S201 Water Flow Sensor (flow 2) ────────────────────
// Yellow wire → GPIO 26 (interrupt), Red → 5V, Black → GND
#define yf_s201_PIN 26
float yf_s201_cal_factor = 450.0;
volatile unsigned long yf_s201_pulseCount = 0;
unsigned long yf_s201_lastPulses = 0;  // last sampled count (for POST/calibration)
float yf_s201_flowRate = 0;
float yf_s201_totalVolume = 0;
void IRAM_ATTR yf_s201_pulseCounter() { yf_s201_pulseCount++; }
// ── Float Sensor 3 ───────────────────────────────────────
#define float_sensor_3_PIN 33
int float_sensor_3_level = 0;
// ── Ping handler (WiFi WebServer) ────────────────────────
// Farm OS calls this to check if the node is alive.
// Returns per-channel status so the dashboard shows what's up/down.
void handlePing() {
  char response[512];
  int wifi_up = (WiFi.status() == WL_CONNECTED) ? 1 : 0;
  snprintf(response, sizeof(response),
    "{\"type\":\"pong\",\"node_id\":\"%s\",\"uptime_seconds\":%u,\"wifi_rssi\":%d,\"free_heap_bytes\":%u,\"ch_wifi\":%d,\"ch_serial\":1}",
    NODE_ID, (unsigned int)(millis() / 1000), WiFi.RSSI(), ESP.getFreeHeap(), wifi_up);
  server.send(200, "application/json", response);
}
// ═══════════════════════════════════════════════════════════════
//  RUNTIME POWER MODE — stored in NVS, changeable via serial
//  Send POWER:low_power / POWER:solar / POWER:powered
// ═══════════════════════════════════════════════════════════════
Preferences nvsPrefs;
// Power mode constants — match power_packages.json keys
#define PM_LOW_POWER  0  // low_power_remote — deep sleep
#define PM_SOLAR      1  // solar_node — light sleep
#define PM_POWERED    2  // powered_node — always on
// Compiled default (from power_packages.json): powered_node
uint8_t powerMode = PM_POWERED;
// Timing — set by applyPowerMode(), used in loop()
const unsigned long defaultSensorIntervalMs = 5000UL;  // restore to this when test mode is off
unsigned long sensorIntervalMs  = 5000UL;
unsigned long transmitIntervalMs = 5000UL;
void applyPowerMode(uint8_t mode) {
  powerMode = mode;
  switch (mode) {
    case PM_LOW_POWER:
      sensorIntervalMs  = 900000UL;   // 15 min
      transmitIntervalMs = 900000UL;
      Serial.println("  POWER MODE: low_power (deep sleep / duty cycle)");
      break;
    case PM_SOLAR:
      sensorIntervalMs  = 120000UL;   // 2 min
      transmitIntervalMs = 120000UL;
      Serial.println("  POWER MODE: solar (light sleep / duty cycle)");
      break;
    case PM_POWERED:
    default:
      sensorIntervalMs  = 5000UL;     // 5s
      transmitIntervalMs = 5000UL;
      Serial.println("  POWER MODE: powered (always on)");
      break;
  }
}
void loadPowerModeFromNVS() {
  nvsPrefs.begin("farmos", true);  // read-only
  uint8_t stored = nvsPrefs.getUChar("pwr_mode", 255);
  nvsPrefs.end();
  if (stored <= 2) {
    Serial.print("  NVS power mode override: ");
    Serial.println(stored);
    applyPowerMode(stored);
  } else {
    applyPowerMode(PM_POWERED);  // compiled default
  }
}
void savePowerModeToNVS(uint8_t mode) {
  nvsPrefs.begin("farmos", false);  // read-write
  nvsPrefs.putUChar("pwr_mode", mode);
  nvsPrefs.end();
  Serial.println("  Power mode saved to NVS — persists across reboots.");
}
// Parse serial commands: POWER:low_power, POWER:solar, POWER:powered, POWER:reset
bool handlePowerCommand(const String& cmd) {
  if (!cmd.startsWith("POWER:")) return false;
  String mode = cmd.substring(6);
  mode.trim();
  if (mode == "low_power" || mode == "low") {
    applyPowerMode(PM_LOW_POWER);
    savePowerModeToNVS(PM_LOW_POWER);
  } else if (mode == "solar" || mode == "medium") {
    applyPowerMode(PM_SOLAR);
    savePowerModeToNVS(PM_SOLAR);
  } else if (mode == "powered" || mode == "high") {
    applyPowerMode(PM_POWERED);
    savePowerModeToNVS(PM_POWERED);
  } else if (mode == "reset") {
    // Clear NVS override — revert to compiled default on next boot
    nvsPrefs.begin("farmos", false);
    nvsPrefs.remove("pwr_mode");
    nvsPrefs.end();
    applyPowerMode(PM_POWERED);
    Serial.println("  Power mode reset to compiled default.");
  } else {
    Serial.println("  Unknown power mode. Use: low_power, solar, powered, reset");
    return false;
  }
  return true;
}
// ── Config Query — ask Farm OS Server where to send data ────
// Queries GET /api/v1/node-config/{node} on the production server.
// Response: {"server_ip":"x.x.x.x","server_port":5050,"mode":"production"}
void fetchServerConfig() {
  if (WiFi.status() != WL_CONNECTED) return;
  HTTPClient http;
  http.begin("http://" + String(PROD_SERVER_IP) + ":" + String(PROD_SERVER_PORT) + "/api/v1/node-config/rain_tank_by32");
  http.setTimeout(3000);
  int httpCode = http.GET();
  if (httpCode == 200) {
    String body = http.getString();
    // Simple JSON parsing — find "server_ip":"..." and "server_port":...
    int ipStart = body.indexOf("\"server_ip\":\"");
    if (ipStart >= 0) {
      ipStart += 13;
      int ipEnd = body.indexOf("\"", ipStart);
      if (ipEnd > ipStart && (ipEnd - ipStart) < 16) {
        String newIP = body.substring(ipStart, ipEnd);
        newIP.toCharArray(targetServerIP, 16);
      }
    }
    int portStart = body.indexOf("\"server_port\":");
    if (portStart >= 0) {
      portStart += 14;
      int portEnd = body.indexOf(",", portStart);
      if (portEnd < 0) portEnd = body.indexOf("}", portStart);
      if (portEnd > portStart) {
        targetServerPort = body.substring(portStart, portEnd).toInt();
      }
    }
    int siStart = body.indexOf("\"sensor_interval_ms\":");
    if (siStart >= 0) {
      siStart += 22;
      int siEnd = body.indexOf(",", siStart);
      if (siEnd < 0) siEnd = body.indexOf("}", siStart);
      if (siEnd > siStart) {
        unsigned long newInterval = body.substring(siStart, siEnd).toInt();
        if (newInterval >= 1000 && newInterval != sensorIntervalMs) {
          sensorIntervalMs = newInterval;
          transmitIntervalMs = newInterval;
          Serial.print("  Config: interval → ");
          Serial.print(newInterval);
          Serial.println("ms");
        }
      }
    } else if (sensorIntervalMs != defaultSensorIntervalMs) {
      // No interval in config = test mode off, restore defaults
      sensorIntervalMs = defaultSensorIntervalMs;
      transmitIntervalMs = defaultSensorIntervalMs;
      Serial.println("  Config: interval → default");
    }
    Serial.print("  Config: target → ");
    Serial.print(targetServerIP);
    Serial.print(":");
    Serial.println(targetServerPort);
  } else {
    Serial.print("  Config query failed (HTTP ");
    Serial.print(httpCode);
    Serial.println(") — using defaults");
  }
  http.end();
}
void setup() {
  Serial.begin(115200);
  Serial.println("NODE:rain_tank_by32:BOOT");
  // Load power mode — NVS override or compiled default
  loadPowerModeFromNVS();
  // Connect to WiFi
  Serial.print("  Connecting to WiFi: ");
  Serial.println(WIFI_SSID);
  WiFi.begin(WIFI_SSID, WIFI_PASSWORD);
  int wifi_attempts = 0;
  while (WiFi.status() != WL_CONNECTED && wifi_attempts < 10) {
    delay(500);
    Serial.print(".");
    wifi_attempts++;
  }
  if (WiFi.status() == WL_CONNECTED) {
    Serial.println("");
    Serial.print("  WiFi connected. IP: ");
    Serial.println(WiFi.localIP());
    Serial.println("  Copy that IP into the node config.json as \"ip_address\"");
  } else {
    Serial.println("  WiFi connection FAILED — ping will not work.");
  }
  // Keep WiFi alive across disconnects and reboots
  WiFi.setAutoReconnect(true);
  WiFi.persistent(true);
  // Register HTTP routes and start the web server
  server.on("/ping", HTTP_GET, handlePing);
  server.begin();
  Serial.println("  Web server started on port 80.");
  // Setup: yf_s201_2 (flow sensor 1 on GPIO 25)
  pinMode(yf_s201_2_PIN, INPUT_PULLUP);
  attachInterrupt(digitalPinToInterrupt(yf_s201_2_PIN), yf_s201_2_pulseCounter, FALLING);
  // Setup: float_sensor (GPIO 13)
  pinMode(float_sensor_PIN, INPUT_PULLUP);
  // Setup: float_sensor_2 (GPIO 14)
  pinMode(float_sensor_2_PIN, INPUT_PULLUP);
  // Setup: yf_s201 (flow sensor 2 on GPIO 26)
  pinMode(yf_s201_PIN, INPUT_PULLUP);
  attachInterrupt(digitalPinToInterrupt(yf_s201_PIN), yf_s201_pulseCounter, FALLING);
  // Setup: float_sensor_3 (GPIO 33)
  pinMode(float_sensor_3_PIN, INPUT_PULLUP);
  // Watchdog: auto-reboot if loop hangs for 30 seconds
  esp_task_wdt_config_t wdt_config = {
    .timeout_ms = 30000,
    .idle_core_mask = 0,
    .trigger_panic = true
  };
  esp_task_wdt_reconfigure(&wdt_config);
  esp_task_wdt_add(NULL);
  // ── Query server config (dev/prod mode) ───────────────────
  delay(1000);  // Let network settle
  fetchServerConfig();
}
// ═══════════════════════════════════════════════════════════════
//  sendToServer — priority-based channel fallback
//  Priority: wifi → serial
// ═══════════════════════════════════════════════════════════════
bool sendToServer(const char* endpoint, const char* payload) {
  // ── Try WiFi ──────────────────────────────────────────────
  if (WiFi.status() == WL_CONNECTED) {
    HTTPClient _http;
    String _url = "http://" + String(targetServerIP) + ":" + String(targetServerPort) + String(endpoint);
    _http.begin(_url);
    _http.setTimeout(3000);  // 3s — don't block long enough to trip WDT
    _http.addHeader("Content-Type", "application/json");
    _http.addHeader("X-API-Key", "farm-ope-5e355vx0");
    int _code = _http.POST(payload);
    _http.end();
    if (_code == 200 || _code == 201) {
      Serial.println("  -> Sent via WiFi");
      return true;
    } else {
      Serial.print("  -> WiFi POST failed, HTTP ");
      Serial.println(_code);
    }
  }
  // ── Fallback: Serial (USB bridge reads this) ──────────────
  return false;  // Caller handles Serial.print for sensor lines
}

// ═══════════════════════════════════════════════════════════════
//  MAIN LOOP
//
//  Timing strategy:
//    - Flow sensors: 1-second millis timer (needed for accurate rate calc)
//    - Float sensors: 1-second millis timer (no blocking delays)
//    - POST to server: transmitIntervalMs millis timer
//    - Deep sleep: reads/POSTs unconditionally (only one loop before reboot)
//    - Powered mode: 50ms yield keeps web server responsive
// ═══════════════════════════════════════════════════════════════
void loop() {
  esp_task_wdt_reset();
  // ── Re-check server config every CONFIG_CHECK_INTERVAL ─────
  if (millis() - lastConfigCheck > CONFIG_CHECK_INTERVAL) {
    lastConfigCheck = millis();
    fetchServerConfig();
  }
  // Handle incoming HTTP requests (ping from Farm OS)
  server.handleClient();

  // ── Flow sensors — 1-second millis timer ───────────────────
  // Interrupts count pulses continuously; we sample every 1s for rate calc.
  static unsigned long flowLastMillis = 0;
  bool flowReady = (powerMode == PM_LOW_POWER) || (millis() - flowLastMillis >= 1000);
  if (flowReady) {
    flowLastMillis = millis();

    // -- yf_s201_2 (flow sensor 1, GPIO 25) --
    detachInterrupt(digitalPinToInterrupt(yf_s201_2_PIN));
    unsigned long yf2_pulses = yf_s201_2_pulseCount;
    yf_s201_2_pulseCount = 0;
    yf_s201_2_lastPulses = yf2_pulses;
    yf_s201_2_flowRate = (yf2_pulses * 60.0) / yf_s201_2_cal_factor;
    yf_s201_2_totalVolume += yf_s201_2_flowRate / 60.0;
    Serial.print("yf_s201_2_pulse_count:"); Serial.println(yf2_pulses);
    Serial.print("yf_s201_2_flow_rate:");   Serial.println(yf_s201_2_flowRate);
    Serial.print("yf_s201_2_total_volume:"); Serial.println(yf_s201_2_totalVolume);
    attachInterrupt(digitalPinToInterrupt(yf_s201_2_PIN), yf_s201_2_pulseCounter, FALLING);

    // -- yf_s201 (flow sensor 2, GPIO 26) --
    detachInterrupt(digitalPinToInterrupt(yf_s201_PIN));
    unsigned long yf1_pulses = yf_s201_pulseCount;
    yf_s201_pulseCount = 0;
    yf_s201_lastPulses = yf1_pulses;
    yf_s201_flowRate = (yf1_pulses * 60.0) / yf_s201_cal_factor;
    yf_s201_totalVolume += yf_s201_flowRate / 60.0;
    Serial.print("yf_s201_pulse_count:"); Serial.println(yf1_pulses);
    Serial.print("yf_s201_flow_rate:");   Serial.println(yf_s201_flowRate);
    Serial.print("yf_s201_total_volume:"); Serial.println(yf_s201_totalVolume);
    attachInterrupt(digitalPinToInterrupt(yf_s201_PIN), yf_s201_pulseCounter, FALLING);

    Serial.flush();
  }

  // ── Float sensors — 1-second millis timer (no blocking delay) ──
  static unsigned long floatLastMillis = 0;
  bool floatReady = (powerMode == PM_LOW_POWER) || (millis() - floatLastMillis >= 1000);
  if (floatReady) {
    floatLastMillis = millis();

    float_sensor_level   = digitalRead(float_sensor_PIN);
    float_sensor_2_level = digitalRead(float_sensor_2_PIN);
    float_sensor_3_level = digitalRead(float_sensor_3_PIN);

    Serial.print("float_sensor_level:");   Serial.println(float_sensor_level);
    Serial.print("float_sensor_2_level:"); Serial.println(float_sensor_2_level);
    Serial.print("float_sensor_3_level:"); Serial.println(float_sensor_3_level);
    Serial.flush();
  }

  // ── POST sensor readings — transmitIntervalMs timer ────────
  // In deep sleep mode, always POST (only one loop before reboot).
  static unsigned long postLastMillis = 0;
  bool doPost = (powerMode == PM_LOW_POWER) || (millis() - postLastMillis >= transmitIntervalMs);
  if (doPost) {
    postLastMillis = millis();
    char _postBuf[256];

    // Flow sensor 1 readings
    snprintf(_postBuf, sizeof(_postBuf),
      "{\"node_name\":\"rain_tank_by32\",\"sensor\":\"yf_s201_2_pulse_count\",\"value\":%lu}",
      yf_s201_2_lastPulses);
    sendToServer("/api/v1/sensor_reading", _postBuf);
    esp_task_wdt_reset();

    snprintf(_postBuf, sizeof(_postBuf),
      "{\"node_name\":\"rain_tank_by32\",\"sensor\":\"yf_s201_2_flow_rate\",\"value\":%.2f}",
      yf_s201_2_flowRate);
    sendToServer("/api/v1/sensor_reading", _postBuf);
    esp_task_wdt_reset();

    snprintf(_postBuf, sizeof(_postBuf),
      "{\"node_name\":\"rain_tank_by32\",\"sensor\":\"yf_s201_2_total_volume\",\"value\":%.2f}",
      yf_s201_2_totalVolume);
    sendToServer("/api/v1/sensor_reading", _postBuf);
    esp_task_wdt_reset();

    // Flow sensor 2 readings
    snprintf(_postBuf, sizeof(_postBuf),
      "{\"node_name\":\"rain_tank_by32\",\"sensor\":\"yf_s201_pulse_count\",\"value\":%lu}",
      yf_s201_lastPulses);
    sendToServer("/api/v1/sensor_reading", _postBuf);
    esp_task_wdt_reset();

    snprintf(_postBuf, sizeof(_postBuf),
      "{\"node_name\":\"rain_tank_by32\",\"sensor\":\"yf_s201_flow_rate\",\"value\":%.2f}",
      yf_s201_flowRate);
    sendToServer("/api/v1/sensor_reading", _postBuf);
    esp_task_wdt_reset();

    snprintf(_postBuf, sizeof(_postBuf),
      "{\"node_name\":\"rain_tank_by32\",\"sensor\":\"yf_s201_total_volume\",\"value\":%.2f}",
      yf_s201_totalVolume);
    sendToServer("/api/v1/sensor_reading", _postBuf);
    esp_task_wdt_reset();

    // Float sensor readings
    snprintf(_postBuf, sizeof(_postBuf),
      "{\"node_name\":\"rain_tank_by32\",\"sensor\":\"float_sensor_level\",\"value\":%d}",
      float_sensor_level);
    sendToServer("/api/v1/sensor_reading", _postBuf);
    esp_task_wdt_reset();

    snprintf(_postBuf, sizeof(_postBuf),
      "{\"node_name\":\"rain_tank_by32\",\"sensor\":\"float_sensor_2_level\",\"value\":%d}",
      float_sensor_2_level);
    sendToServer("/api/v1/sensor_reading", _postBuf);
    esp_task_wdt_reset();

    snprintf(_postBuf, sizeof(_postBuf),
      "{\"node_name\":\"rain_tank_by32\",\"sensor\":\"float_sensor_3_level\",\"value\":%d}",
      float_sensor_3_level);
    sendToServer("/api/v1/sensor_reading", _postBuf);
    esp_task_wdt_reset();
  }

  // ── Check Serial for commands ─────────────────────────────
  if (Serial.available()) {
    String serialIn = Serial.readStringUntil('\n');
    serialIn.trim();
    handlePowerCommand(serialIn);
    if (serialIn == "REBOOT") {
      Serial.println("  Rebooting...");
      Serial.flush();
      delay(100);
      ESP.restart();
    }
  }
  // ── Sleep (power mode aware) ──────────────────────────────
  Serial.flush();
  if (powerMode == PM_LOW_POWER) {
    Serial.print("  Deep sleep for ");
    Serial.print(sensorIntervalMs / 1000);
    Serial.println("s...");
    Serial.flush();
    esp_deep_sleep(sensorIntervalMs * 1000ULL);
  } else if (powerMode == PM_SOLAR) {
    Serial.print("  Light sleep for ");
    Serial.print(sensorIntervalMs / 1000);
    Serial.println("s...");
    Serial.flush();
    esp_sleep_enable_timer_wakeup(sensorIntervalMs * 1000ULL);
    esp_light_sleep_start();
  } else {
    // Short yield — keeps web server responsive.
    // Actual read/transmit timing handled by millis timers above.
    delay(50);
  }
}
// ── POWER: powered_node ──────────────────────────────────────────
// Sleep mode determined by NVS-backed power preset.
// Compiled default: powered_node (none, 5s)
// Change at runtime via serial: POWER:low_power / POWER:solar / POWER:powered
